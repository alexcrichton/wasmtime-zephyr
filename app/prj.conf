## CMakeLists.txt
```
cmake_minimum_required(VERSION 3.13.1)
find_package(Zephyr REQUIRED HINTS $ENV{ZEPHYR_BASE})

project(app)

if (${ARCH} STREQUAL arm64)
  set(RUST_TARGET aarch64-unknown-none)
elseif (${ARCH} STREQUAL x86)
  set(RUST_TARGET x86_64-unknown-none)
else ()
  message(FATAL_ERROR "don't know how to compile Rust for ${ARCH}")
endif()

set(WASMTIME_GENERATED_DIR ${CMAKE_CURRENT_BINARY_DIR}/wasmtime-generated)
set(WASMTIME_HEADER ${WASMTIME_GENERATED_DIR}/wasmtime.h)
set(WASMTIME_HEADER_DEPFILE ${WASMTIME_GENERATED_DIR}/wasmtime.h.d)
set(WASMTIME_BINDINGS ${WASMTIME_GENERATED_DIR}/bindings.rs)
set(WASMTIME_BINDINGS_DEPFILE ${WASMTIME_GENERATED_DIR}/bindings.rs.d)
set(WASMTIME_DIR ${CMAKE_CURRENT_SOURCE_DIR}/../wasmtime)
set(WASMTIME_TARGET_ROOT ${CMAKE_CURRENT_BINARY_DIR}/wasmtime-target)
set(WASMTIME_OUTPUT ${WASMTIME_TARGET_ROOT}/${RUST_TARGET}/release/libwasmtime_zephyr.a)
set(WASMTIME_OUTPUT_STRIPPED ${WASMTIME_GENERATED_DIR}/libwasmtime_zephyr_stripped.a)
set(CWASM_OUTPUT ${WASMTIME_GENERATED_DIR}/sample.cwasm)
set(CWASM_INPUT ${WASMTIME_DIR}/src/sample.wat)

target_sources(app PRIVATE
  src/main.c
  src/wasmtime-platform.c
  src/wasmtime_syscalls.c
)

# TODO: is there a better or more automatic way to include a header dir?
zephyr_include_directories(${WASMTIME_GENERATED_DIR})

include(ExternalProject)
find_program(CARGO cargo)
ExternalProject_Add(
  wasmtime_project
  CONFIGURE_COMMAND   ""
  DOWNLOAD_COMMAND    ""
  INSTALL_COMMAND     ""
  # TODO: what RUSTFLAGS should be copied from C to here
  BUILD_COMMAND
    ${CMAKE_COMMAND} -E env
      BINDINGS=${WASMTIME_BINDINGS}
      CWASM=${CWASM_OUTPUT}
      ${CARGO} build
        --release
        --target-dir ${WASMTIME_TARGET_ROOT}
        --target ${RUST_TARGET}
        --color always # TODO: how to read this from cmake
        --quiet
  USES_TERMINAL_BUILD TRUE
  BINARY_DIR          ${WASMTIME_DIR}
  BUILD_ALWAYS        YES
  BUILD_BYPRODUCTS    ${WASMTIME_OUTPUT}
)
add_custom_command(
  OUTPUT ${WASMTIME_OUTPUT_STRIPPED}
  COMMAND ${CMAKE_STRIP} --strip-debug ${WASMTIME_OUTPUT} -o ${WASMTIME_OUTPUT_STRIPPED}
  DEPENDS wasmtime_project
)
add_custom_target(wasmtime_project_stripped DEPENDS ${WASMTIME_OUTPUT_STRIPPED})

add_library(wasmtime_lib STATIC IMPORTED GLOBAL)
add_dependencies(wasmtime_lib wasmtime_project_stripped)
set_target_properties(wasmtime_lib PROPERTIES IMPORTED_LOCATION ${WASMTIME_OUTPUT_STRIPPED})
# TODO: unsure why this didn't work
# set_target_properties(wasmtime_lib PROPERTIES INTERFACE_INCLUDE_DIRECTORIES ${WASMTIME_GENERATED_DIR})

target_link_libraries(app PUBLIC wasmtime_lib)

# TODO: is this the best way to specify this? How else to put the rust lib in
# its own partition?
set_property(TARGET zephyr_property_target
             APPEND PROPERTY COMPILE_OPTIONS
             -l libwasmtime_zephyr_stripped.a z_libc_partition)

# Use the Rust `cbindgen` tool to generate a C header file from Rust code.
find_program(RUST_CBINDGEN cbindgen)
add_custom_command(
  OUTPUT ${WASMTIME_HEADER}
  COMMAND
    ${RUST_CBINDGEN}
      --lang C
      --output ${WASMTIME_HEADER}
      ${WASMTIME_DIR}
      --depfile ${WASMTIME_HEADER_DEPFILE}
  DEPFILE ${WASMTIME_HEADER_DEPFILE}
  BYPRODUCTS ${WASMTIME_HEADER_DEPFILE}
)
add_custom_target(cbindgen_header DEPENDS ${WASMTIME_HEADER})
add_dependencies(app cbindgen_header)

# Use the Rust `bindgen` tool to generate Rust bindings for our C header file.
set(APP_HEADER ${CMAKE_CURRENT_SOURCE_DIR}/../include/app.h)
set(APP_STATIC_FNS ${WASMTIME_GENERATED_DIR}/wasmtime-static-fns.c)
find_program(RUST_BINDGEN bindgen)
zephyr_get_include_directories_for_lang(       C includes)
zephyr_get_system_include_directories_for_lang(C system_includes)
zephyr_get_compile_definitions_for_lang(       C definitions)
execute_process(
  COMMAND ${CMAKE_C_COMPILER} -print-file-name=include
  OUTPUT_VARIABLE GCC_INCLUDE
  OUTPUT_STRIP_TRAILING_WHITESPACE)
execute_process(
  COMMAND ${CMAKE_C_COMPILER} -print-file-name=include-fixed
  OUTPUT_VARIABLE GCC_INCLUDE_FIXED
  OUTPUT_STRIP_TRAILING_WHITESPACE)

# message(HELLO)
# message(${SYSCALL_LIST_H_TARGET})
add_custom_command(
  OUTPUT ${WASMTIME_BINDINGS}
  COMMAND ${RUST_BINDGEN}
    ${APP_HEADER}
    -o ${WASMTIME_BINDINGS}
    --use-core
    --no-layout-tests
    --experimental
    --wrap-static-fns
    --wrap-static-fns-path ${APP_STATIC_FNS}
    --merge-extern-blocks
    --no-doc-comments
    --allowlist-file .*i2c.h
    --allowlist-file .*app.h
    --opaque-type device_state
    --depfile ${WASMTIME_BINDINGS_DEPFILE}
    --
    ${includes}
    ${system_includes}
    ${definitions}
    -imacros ${AUTOCONF_H}
    --target=${RUST_TARGET}
    -nostdinc
    -I ${SYSROOT_DIR}/include
    -I ${SYSROOT_DIR}/sys-include
    -I ${GCC_INCLUDE}
    -I ${GCC_INCLUDE_FIXED}

  # Depend on the `zephyr_interface` target in Zephyr itself since this depends
  # on generated headers being available.
  DEPENDS zephyr_interface
  DEPFILE ${WASMTIME_BINDINGS_DEPFILE}
  VERBATIM
  COMMAND_EXPAND_LISTS
  BYPRODUCTS ${APP_STATIC_FNS} ${WASMTIME_BINDINGS_DEPFILE}
)
ExternalProject_Add_StepDependencies(wasmtime_project build ${WASMTIME_BINDINGS})
target_sources(app PRIVATE ${APP_STATIC_FNS})

# Use a local wasmtime install to recompile the `sample.wat`
add_custom_command(
  OUTPUT ${CWASM_OUTPUT}
  COMMAND
    cargo run
      --manifest-path /home/alex/code/wasmtime/Cargo.toml
      --features all-arch
      -q
      compile
      --target ${RUST_TARGET}
      ${CWASM_INPUT}
      --wasm reference-types=n
      --wasm threads=n
      -O static-memory-maximum-size=0
      -O dynamic-memory-guard-size=0
      -O dynamic-memory-reserved-for-growth=0
      -O guard-before-linear-memory=n
      -o ${CWASM_OUTPUT}
  DEPENDS ${CWASM_INPUT}
)
ExternalProject_Add_StepDependencies(wasmtime_project build ${CWASM_OUTPUT})
```

## Kconfig
```
# Copyright (c) 2021 Nordic Semiconductor ASA
# SPDX-License-Identifier: Apache-2.0
#
# This file is the application Kconfig entry point. All application Kconfig
# options can be defined here or included via other application Kconfig files.
# You can browse these options using the west targets menuconfig (terminal) or
# guiconfig (GUI).

menu "Zephyr"
source "Kconfig.zephyr"
endmenu

config WASMTIME_HEAP_SIZE
  int "Size of memory for the `*.cwasm` image and linear memory"
  default 2097152

config WASMTIME_NUM_MMAPS
  int "Maximum number of mmaps to support"
  default 8

module = APP
module-str = APP
source "subsys/logging/Kconfig.template.log_config"
```

## sample.yaml
```
# This file is provided so that the application can be compiled using Twister,
# the Zephyr testing tool. In this file, multiple combinations can be specified,
# so that you can easily test all of them locally or in CI.
sample:
  description: Example application
  name: example-application
common:
  build_only: true
  integration_platforms:
    - custom_plank
    - nucleo_f302r8
tests:
  app.default: {}
  app.debug:
    extra_overlay_confs:
      - debug.conf
```

## prj.conf
```kconfig
# Copyright (c) 2021 Nordic Semiconductor ASA
# SPDX-License-Identifier: Apache-2.0
#
# This file contains selected Kconfig options for the application.

CONFIG_USERSPACE=y
CONFIG_MMU=y
CONFIG_APPLICATION_DEFINED_SYSCALL=y
CONFIG_I2C=y

# debugging
CONFIG_CONSOLE=y
CONFIG_ASSERT=y
CONFIG_LOG=y
```

## src/main.c
```c
#include <zephyr/kernel.h>
#include <app_version.h>
#include <zephyr/sys/libc-hooks.h>
#include <zephyr/logging/log_ctrl.h>
#include <stdio.h>
#include <stdlib.h>

#include "app.h"
#include "wasmtime.h"
#include "wasmtime_syscalls.h"

static void user_thread(void *p1, void *p2, void *p3) {
  int a = 1;
  int b = 2;
  int result = rust_add(a, b);

  printk("according to wasm %d + %d = %d\n", a, b, result);

  // NB: refer to `rust_run` in a way it can't be optimized away.
  // TODO: how to create a `const struct device*` to run i2c stuff on?
  if (result == 4)
    rust_run(NULL);
}

#define MY_STACK_SIZE (512 << 10)
#define MY_PRIORITY -5
K_THREAD_DEFINE(my_tid, MY_STACK_SIZE,
                user_thread, NULL, NULL, NULL,
                MY_PRIORITY, K_USER, -1);

int main(void) {
  struct k_mem_partition *parts[] = {
    &z_libc_partition,
    &z_malloc_partition,
  };
  k_mem_domain_init(&wasmtime_domain, 2, parts);
  k_mem_domain_add_thread(&wasmtime_domain, my_tid);
  k_thread_start(my_tid);
  return 0;
}

// Used in rust panic messages to print things.
void app_printk(const uint8_t *ptr, size_t len) {
  // TODO: is there a more appropriate stream to use other than `printk`?
  printk("%.*s", (int) len, (const char*) ptr);
}

// Used in rust to to abort on a panic.
void app_abort() {
  abort();
}

// Memory allocation for Rust
void* app_alloc(size_t size, size_t align) {
  return aligned_alloc(align, size);
}

// Memory deallocation for Rust
void app_dealloc(void *ptr) {
  free(ptr);
}
```

## src/wasmtime-platform.c
```c
#include <zephyr/kernel.h>
#include <zephyr/app_memory/app_memdomain.h>
#include <assert.h>
#include <wasmtime-platform.h>

#include "wasmtime_syscalls.h"

// These are turned into custom syscalls defined in our custom zephyr kernel
int wasmtime_mmap_new(uintptr_t size, uint32_t prot_flags, uint8_t **ret) {
  return mmap_new(size, prot_flags, (void**) ret);
}

int wasmtime_mmap_remap(uint8_t *addr, uintptr_t size, uint32_t prot_flags) {
  return mmap_remap(addr, size, prot_flags);
}

int wasmtime_munmap(uint8_t *ptr, uintptr_t size) {
  return mmap_munmap(ptr, size);
}

int wasmtime_mprotect(uint8_t *ptr, uintptr_t size, uint32_t prot_flags) {
  return mmap_mprotect(ptr, size, prot_flags);
}

uintptr_t wasmtime_page_size(void) {
  return CONFIG_MMU_PAGE_SIZE;
}

int32_t wasmtime_setjmp(const uint8_t **jmp_buf_out,
                        void (*callback)(uint8_t *, uint8_t *),
                        uint8_t *payload, uint8_t *callee) {
  // TODO: fill this in
  callback(payload, callee);
  return 1;
}

void wasmtime_longjmp(const uint8_t *jmp_buf_ptr) {
  // TODO: fill this in
  abort();
}

int wasmtime_init_traps(wasmtime_trap_handler_t handler) {
  // TODO: fill this in
  return 0;
}

int wasmtime_memory_image_new(const uint8_t *ptr, uintptr_t len,
                              struct wasmtime_memory_image **ret) {
  *ret = NULL;
  return 0;
}

int wasmtime_memory_image_map_at(struct wasmtime_memory_image *image,
                                 uint8_t *addr, uintptr_t len) {
  abort();
}

void wasmtime_memory_image_free(struct wasmtime_memory_image *image) {
  abort();
}

// NB: only one thread right now so this is just a `static`, not actually thread
// local.
K_APP_BMEM(z_libc_partition) static uint8_t *wasmtime_tls = NULL;

uint8_t* wasmtime_tls_get(void) {
  return wasmtime_tls;
}

void wasmtime_tls_set(uint8_t *ptr) {
  wasmtime_tls = ptr;
}
```

## src/wasmtime_syscalls.c
```c
#include <zephyr/kernel.h>
#include <zephyr/internal/syscall_handler.h>
#include <zephyr/logging/log.h>
#include "wasmtime_syscalls.h"
#include "wasmtime-platform.h"

#define MAX_PARTITIONS 8

LOG_MODULE_REGISTER(wasmtime_syscalls);

struct k_mem_domain wasmtime_domain;

// This heap is where "mmap'd memory" is allocated from.
//
// If this could be in flash memory then it should. I don't know how to do that
// in zephyr right now so it's instead here in the data section.
K_HEAP_DEFINE(wasmtime_heap, CONFIG_WASMTIME_HEAP_SIZE);

struct wasmtime_mmap {
  uint8_t *base;
  size_t len;
  struct k_mem_partition partitions[MAX_PARTITIONS];
  size_t num_partitions;
};

static struct {
  size_t num_mmaps;
  struct wasmtime_mmap mmaps[CONFIG_WASMTIME_NUM_MMAPS];
} wasmtime_mmaps = {0};

// Find the mmap in `wasmtime_mmaps` which contains `base`.
static int find_mmap_containing(uint8_t *base) {
  for (int i = 0; i < wasmtime_mmaps.num_mmaps; i++) {
    struct wasmtime_mmap *map = &wasmtime_mmaps.mmaps[i];
    if (map->base <= base && base < map->base + map->len)
      return i;
  }
  LOG_ERR("failed to find mmap");
  return -EINVAL;
}

// Converts wasmtime `flags` to zephyr `k_mem_partition_attr_t`.
static k_mem_partition_attr_t flags_to_attrs(uint32_t flags) {
  if (flags == (WASMTIME_PROT_READ | WASMTIME_PROT_WRITE)) {
    return K_MEM_PARTITION_P_RW_U_RW;
  }
  if (flags == (WASMTIME_PROT_READ | WASMTIME_PROT_EXEC)) {
    return K_MEM_PARTITION_P_RX_U_RX;
  }
  if (flags == WASMTIME_PROT_READ) {
    return K_MEM_PARTITION_P_RO_U_RO;
  }
  if (flags == 0) {
    return K_MEM_PARTITION_P_RO_U_NA;
  }
  LOG_ERR("invalid permission flags for new mmap: %x", flags);
  abort();
}

// Adds a new partition to both `map` and `wasmtime_domain`.
static int add_partition(struct wasmtime_mmap *map,
                         void *base,
                         size_t size,
                         k_mem_partition_attr_t attr) {
  if (size == 0)
    return 0;
  if (map->num_partitions == MAX_PARTITIONS) {
    LOG_ERR("cannot add more partitions");
    return -ENOMEM;
  }
  struct k_mem_partition *partition = &map->partitions[map->num_partitions];
  partition->start = (uintptr_t) base;
  partition->size = size;
  partition->attr = attr;

  map->num_partitions += 1;
  return k_mem_domain_add_partition(&wasmtime_domain, partition);
}

int z_impl_mmap_new(size_t size, uint32_t flags, void **ret) {
  if (wasmtime_mmaps.num_mmaps == CONFIG_WASMTIME_NUM_MMAPS) {
    LOG_ERR("no more space for mmaps");
    return -ENOMEM;
  }
  struct wasmtime_mmap *map = &wasmtime_mmaps.mmaps[wasmtime_mmaps.num_mmaps];

  map->base = k_heap_aligned_alloc(&wasmtime_heap, CONFIG_MMU_PAGE_SIZE, size, K_NO_WAIT);

  if (map->base == NULL) {
    LOG_ERR("no more memory to allocate");
    return -ENOMEM;
  }
  map->len = size;
  map->num_partitions = 0;
  k_mem_partition_attr_t attr = flags_to_attrs(flags);
  int rc = add_partition(map, map->base, size, attr);
  if (rc != 0) {
    k_heap_free(&wasmtime_heap, map->base);
    return rc;
  }

  wasmtime_mmaps.num_mmaps++;
  *ret = map->base;
  return 0;
}

static int z_vrfy_mmap_new(size_t size, uint32_t flags, void **ret) {
  void *my_ret = NULL;
  if (size % CONFIG_MMU_PAGE_SIZE != 0) {
    LOG_ERR("size is not page-aligned");
    return -EINVAL;
  }
  int rc = z_impl_mmap_new(size, flags, &my_ret);
  K_OOPS(k_usermode_to_copy(ret, &my_ret, sizeof(my_ret)));
  return rc;
}

int z_impl_mmap_remap(void *addr, size_t size, uint32_t flags) {
  LOG_ERR("unimplemented remap");
  return -EINVAL;
}

static int z_vrfy_mmap_remap(void *addr, size_t size, uint32_t flags) {
  return z_impl_mmap_remap(addr, size, flags);
}

int z_impl_mmap_munmap(void *addr, size_t size) {
  int mapi = find_mmap_containing(addr);
  if (mapi < 0)
    return mapi;
  struct wasmtime_mmap *map = &wasmtime_mmaps.mmaps[mapi];
  if (map->base != addr || map->len != size) {
    LOG_ERR("failed to find mmap");
    return -EINVAL;
  }
  for (int i = 0; i < map->num_partitions; i++) {
    k_mem_domain_remove_partition(&wasmtime_domain, &map->partitions[i]);
  }
  k_heap_free(&wasmtime_heap, map->base);
  if (wasmtime_mmaps.num_mmaps > 1) {
    wasmtime_mmaps.mmaps[mapi] = wasmtime_mmaps.mmaps[wasmtime_mmaps.num_mmaps - 1];
  }
  wasmtime_mmaps.num_mmaps -= 1;
  return 0;
}

static int z_vrfy_mmap_munmap(void *addr, size_t size) {
  return z_impl_mmap_munmap(addr, size);
}

static size_t round_up(size_t size) {
  return (size + (CONFIG_MMU_PAGE_SIZE - 1)) & ~(CONFIG_MMU_PAGE_SIZE - 1);
}

int z_impl_mmap_mprotect(void *addr, size_t not_rounded_size, uint32_t flags) {
  size_t size = round_up(not_rounded_size);
  int mapi = find_mmap_containing(addr);
  if (mapi < 0)
    return mapi;

  struct wasmtime_mmap *map = &wasmtime_mmaps.mmaps[mapi];
  if (size > map->len) {
    LOG_ERR("size too large");
    return -EINVAL;
  }
  int rc = 0;

  int num_partitions = map->num_partitions;
  map->num_partitions = 0;
  for (int i = 0; i < num_partitions; i++) {
    rc = k_mem_domain_remove_partition(&wasmtime_domain, &map->partitions[i]);
    if (rc != 0) {
      LOG_ERR("failed to remove partition");
      return rc;
    }
  }

  // handle changing the permissions of the entire mmap
  if (addr == map->base && size == map->len) {
    return add_partition(map, addr, size, flags_to_attrs(flags));
  }

  // handle splitting a single mmap
  if (num_partitions == 1) {
    k_mem_partition_attr_t prev_attrs = map->partitions[0].attr;
    uint8_t *base = map->base;
    size_t base_len = ((uintptr_t) addr) - ((uintptr_t) base);
    uint8_t *mid = base + base_len;
    size_t mid_len = size;
    uint8_t *end = mid + mid_len;
    size_t end_len = map->len - mid_len - base_len;

    rc = add_partition(map, base, base_len, prev_attrs);
    if (rc == 0)
      rc = add_partition(map, mid, mid_len, flags_to_attrs(flags));
    if (rc == 0)
      rc = add_partition(map, end, end_len, prev_attrs);
    return rc;
  }

  LOG_ERR("unimplemented mmap_mprotect configuration");
  return -EINVAL;
}

static int z_vrfy_mmap_mprotect(void *addr, size_t size, uint32_t flags) {
  return z_impl_mmap_mprotect(addr, size, flags);
}

#include <syscalls/mmap_mprotect_mrsh.c>
#include <syscalls/mmap_munmap_mrsh.c>
#include <syscalls/mmap_new_mrsh.c>
#include <syscalls/mmap_remap_mrsh.c>
```

## src/wasmtime_syscalls.h
```c
#ifndef WASMTIME_SYSCALLS_H
#define WASMTIME_SYSCALLS_H

#include <zephyr/toolchain.h>
#include <stdint.h>
#include <stddef.h>

extern struct k_mem_domain wasmtime_domain;

__syscall int mmap_new(size_t size, uint32_t flags, void **ret);
__syscall int mmap_remap(void *addr, size_t size, uint32_t flags);
__syscall int mmap_munmap(void *ptr, size_t size);
__syscall int mmap_mprotect(void *ptr, size_t size, uint32_t prot);

#include <syscalls/wasmtime_syscalls.h>

#endif /* WASMTIME_SYSCALLS_H */
```
